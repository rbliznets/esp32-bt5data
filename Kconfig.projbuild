## Kconfig.projbuild
```kconfig
menu "BLE Data (NimBLE)"
    depends on BT_NIMBLE_ENABLED

    config BLE_DATA_DEVICE_NAME
        string "Device name"
        default "BLE Data"
        help
            Device name

    choice
        prompt "Choose core for the BLE Data task"
        default BLE_DATA_TASK0

        config BLE_DATA_TASK0
            bool "core 0"

        config BLE_DATA_TASK1
            bool "core 1"

    endchoice

    config BLE_DATA_SECOND_CHANNEL
        bool "Second channel enabled"
        default y
        help
            Speed up data stream.

    config BLE_DATA_PAIRING
        bool "Just Works pairing"
        depends on BT_NIMBLE_SECURITY_ENABLE
        default y
        help
            Offer Just Works pairing (LE Secure Connections, no MITM protection)
            on connect and bond the client. The link is protected from passive
            eavesdropping only. Enable BT_NIMBLE_NVS_PERSIST so that bonds survive
            a reboot, otherwise bonded clients fail to encrypt afterwards.

    config BLE_DATA_REQUIRE_ENCRYPTION
        bool "Require encrypted link for data writes"
        depends on BLE_DATA_PAIRING
        default n
        help
            The data characteristics accept writes only over an encrypted link,
            so clients that do not pair lose the BLE data channel. Without it
            unencrypted clients are still served.

    config BLE_DATA_EXT_ADV_RANDOM_ADDR
        depends on BT_NIMBLE_EXT_ADV
        bool "Random address for extended advertising"
        default n
        help
            Extended data advertising uses a random (non-resolvable private)
            address generated on every start. Otherwise it uses the device
            address, the same as legacy advertising.

    config BLE_DATA_IBEACON_SCAN
        bool "BLE scan enabled"
        default n
        help
            BLE scan code included.

    config BLE_DATA_IBEACON_SCAN_TIMER
        depends on BLE_DATA_IBEACON_SCAN
        int "Set scan time in ms."
        range 1000 10000
        default 1500
        help
            Set scan time in ms. 

    config BLE_DATA_IBEACON_TX
        bool "iBeacon tx enabled"
        default n
        help
            iBeacon tx included.

    config BLE_DATA_MACSTORE_PSRAM
        depends on SPIRAM
        bool "Allocate CMacStore lists in SPIRAM"
        default n
        help
            Place the MAC/iBeacon scan lists and whitelist used by CMacStore
            in external SPIRAM instead of internal RAM.

endmenu
```
